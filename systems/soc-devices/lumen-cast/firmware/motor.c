/**
 * lumen_cast/firmware/motor.c — TMC2209 stepper motor driver
 *
 * Drives a NEMA8 stepper motor (200 steps/rev × 16 microsteps = 3200 steps/rev)
 * via a Trinamic TMC2209 v1.2 driver module.
 *
 * Step pulses generated by TIM2_CH1 (PA0) in output-compare PWM mode.
 * Direction: PA1 GPIO. Enable: PA2 GPIO (active low).
 *
 * The TMC2209 features:
 *   - StealthChop2 (silent) spreadCycle (torque) modes
 *   - Up to 256 microsteps (configured to 16 via MS pins)
 *   - 2A peak coil current (set by VREF potentiometer on module)
 *   - StallGuard4 (not used here, no encoder feedback)
 *
 * Position tracking: absolute step count → degrees.
 */

#include "main.h"
#include <math.h>

#define TAG "MOTOR"

/* Internal state */
static volatile int32_t s_current_steps = 0;   /* absolute position in steps */
static volatile int32_t s_target_steps = 0;
static volatile bool s_moving = false;
static volatile float s_current_rpm = 15.0f;

/* ── TIM2 step pulse generation ────────────────────────────────────── */
/*
 * TIM2_CH1 generates square wave on PA0.
 * Frequency = (rpm × steps_per_rev) / 60
 * For 15 rpm × 3200 steps = 800 Hz step rate
 * TIM2 clock = 170 MHz, prescaler to get ~1 MHz timer clock
 * ARR = 1MHz / step_freq - 1
 */

static void tim2_step_init(void)
{
    /* Enable TIM2 clock */
    RCC->APB1ENR1 |= RCC_APB1ENR1_TIM2EN;

    /* PA0 as TIM2_CH1 alternate function */
    GPIOA->MODER &= ~(3 << (PIN_STEPPER_STEP * 2));
    GPIOA->MODER |= (2 << (PIN_STEPPER_STEP * 2));  /* AF mode */
    GPIOA->AFR[0] &= ~(0xF << (PIN_STEPPER_STEP * 4));
    GPIOA->AFR[0] |= (1 << (PIN_STEPPER_STEP * 4));  /* AF1 = TIM2 */

    /* TIM2: prescaler for 1 MHz timer clock (170MHz/170) */
    TIM2->PSC = 169;
    TIM2->ARR = 1000 - 1;  /* default 1 kHz */
    TIM2->CCR1 = 500;       /* 50% duty */

    /* Output compare mode: PWM mode 1 on CH1 */
    TIM2->CCMR1 = (6 << TIM_CCMR1_OC1M_Pos) | TIM_CCMR1_OC1PE;
    TIM2->CCER = TIM_CCER_CC1E;  /* enable CH1 output */
    TIM2->EGR = TIM_EGR_UG;       /* update registers */
    /* Don't enable TIM2 yet — start on first move */
}

static void tim2_set_step_freq(float freq_hz)
{
    if (freq_hz < 0.1f) {
        TIM2->CR1 &= ~TIM_CR1_CEN;  /* stop timer */
        return;
    }
    uint32_t arr = (uint32_t)(1000000.0f / freq_hz) - 1;
    if (arr < 10) arr = 10;
    if (arr > 65535) arr = 65535;
    TIM2->ARR = arr;
    TIM2->CCR1 = arr / 2;  /* 50% duty */
    TIM2->EGR = TIM_EGR_UG;
    TIM2->CR1 |= TIM_CR1_CEN;  /* start timer */
}

/* ── DIR and EN pins ───────────────────────────────────────────────── */

static void gpio_dir_en_init(void)
{
    /* PA1 (DIR) and PA2 (EN) as push-pull outputs */
    RCC->AHB2ENR |= RCC_AHB2ENR_GPIOAEN;

    GPIOA->MODER &= ~(3 << (PIN_STEPPER_DIR * 2));
    GPIOA->MODER |= (1 << (PIN_STEPPER_DIR * 2));  /* output */
    GPIOA->OTYPER &= ~(1 << PIN_STEPPER_DIR);

    GPIOA->MODER &= ~(3 << (PIN_STEPPER_EN * 2));
    GPIOA->MODER |= (1 << (PIN_STEPPER_EN * 2));  /* output */
    GPIOA->OTYPER &= ~(1 << PIN_STEPPER_EN);
}

/* ── Public API ────────────────────────────────────────────────────── */

void motor_init(void)
{
    gpio_dir_en_init();
    tim2_step_init();

    /* Disable motor initially (EN active low → set high = disabled) */
    GPIOA->ODR |= (1 << PIN_STEPPER_EN);
    GPIOA->ODR &= ~(1 << PIN_STEPPER_DIR);  /* default CCW */

    s_current_steps = 0;
    s_target_steps = 0;
    s_moving = false;

    LOGI(TAG, "Motor init: NEMA8 3200 steps/rev via TMC2209");
}

void motor_enable(bool en)
{
    if (en)
        GPIOA->ODR &= ~(1 << PIN_STEPPER_EN);  /* EN low = enabled */
    else
        GPIOA->ODR |= (1 << PIN_STEPPER_EN);   /* EN high = disabled */
}

void motor_set_dir(bool clockwise)
{
    if (clockwise)
        GPIOA->ODR |= (1 << PIN_STEPPER_DIR);
    else
        GPIOA->ODR &= ~(1 << PIN_STEPPER_DIR);
}

void motor_move_to_deg(float target_deg, float rpm)
{
    float current_deg = (float)s_current_steps * STEPPER_STEP_DEG;
    float delta_deg = target_deg - current_deg;

    /* Normalize to shortest path */
    while (delta_deg > 180.0f) delta_deg -= 360.0f;
    while (delta_deg < -180.0f) delta_deg += 360.0f;

    int32_t delta_steps = (int32_t)(delta_deg / STEPPER_STEP_DEG);

    /* Set direction */
    motor_set_dir(delta_steps >= 0);

    s_target_steps = s_current_steps + delta_steps;
    s_current_rpm = rpm;

    /* Compute step frequency */
    float step_freq = (rpm * STEPPER_STEPS_PER_REV) / 60.0f;
    tim2_set_step_freq(step_freq);

    s_moving = true;

    /* Enable motor if not already */
    motor_enable(true);
}

void motor_step(int steps)
{
    motor_set_dir(steps >= 0);
    s_target_steps = s_current_steps + steps;
    s_moving = true;
    float step_freq = (s_current_rpm * STEPPER_STEPS_PER_REV) / 60.0f;
    tim2_set_step_freq(step_freq);
    motor_enable(true);
}

/* Called from TIM2 update ISR to track steps */
void motor_step_isr(void)
{
    if (s_moving) {
        if ((GPIOA->ODR >> PIN_STEPPER_DIR) & 1)
            s_current_steps++;
        else
            s_current_steps--;

        if (s_current_steps == s_target_steps) {
            s_moving = false;
            tim2_set_step_freq(0);  /* stop timer */
        }
    }
}

bool motor_at_target(void)
{
    return !s_moving;
}

float motor_get_position_deg(void)
{
    /* Normalize to 0-360 */
    float deg = fmodf((float)s_current_steps * STEPPER_STEP_DEG, 360.0f);
    if (deg < 0) deg += 360.0f;
    return deg;
}

void motor_home(void)
{
    /* Move to 0° position.
     * In a real system, a limit switch or optical home sensor would be used.
     * Here we assume the motor starts at 0° or the user manually aligns it.
     * For production: add a hall-effect or optical home sensor.
     */
    float current = motor_get_position_deg();
    if (current > 0.1f) {
        motor_move_to_deg(0.0f, STEPPER_SCAN_RPM);
    }
    /* Reset step counter to 0 */
    s_current_steps = 0;
    s_target_steps = 0;
    s_moving = false;
    LOGI(TAG, "Motor homed to 0°");
}
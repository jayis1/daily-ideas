/*
 * coincidence.c — RMT-based SiPM discriminator timestamping + coincidence
 *
 * The two SiPM discriminator edges drive RMT channels (ESP32) or are
 * generated by the simulator. When two edges arrive within the
 * coincidence window, we trigger the ADS7946, read both pulse heights,
 * compute Δt, and push a fully-formed event_t into the event ring.
 *
 * Portable core: the pure-C coincidence window check + event assembly
 * is shared between the ESP32 firmware and the host simulation.
 */
#include "coincidence.h"
#include "adc.h"
#include "sky_lens.h"
#include <string.h>

#ifdef SKY_LENS_SIM
#include "port_sim.h"
#else
#include "driver/rmt_rx.h"
#include "driver/gpio.h"
#include "esp_log.h"
#include "freertos/FreeRTOS.h"
#include "freertos/queue.h"
static const char *TAG = "coin";
#endif

/* ── Configuration ────────────────────────────────────────────────────── */
static int32_t s_window_ps = SKY_LENS_WINDOW_NS * 1000;  /* window in ps */
static uint64_t s_count    = 0;

/* ── Last edge timestamps (ps since boot) ─────────────────────────────── */
static int64_t s_stamp0_ps = -1;
static int64_t s_stamp1_ps = -1;

/* ── Pending events ring (simple lock-free SPSC ring for sim/portable) ── */
#define RING_SZ 32
static event_t s_ring[RING_SZ];
static volatile int s_ring_head = 0;  /* producer */
static volatile int s_ring_tail = 0;  /* consumer */

static bool ring_push(const event_t *ev)
{
    int next = (s_ring_head + 1) % RING_SZ;
    if (next == s_ring_tail) return false; /* full, drop */
    s_ring[s_ring_head] = *ev;
    s_ring_head = next;
    return true;
}

bool coincidence_pop(event_t *out)
{
    if (s_ring_tail == s_ring_head) return false;
    *out = s_ring[s_ring_tail];
    s_ring_tail = (s_ring_tail + 1) % RING_SZ;
    return true;
}

void coincidence_set_window_ns(int32_t ns)
{
    if (ns < 5) ns = 5;
    if (ns > 5000) ns = 5000;
    s_window_ps = ns * 1000;
}

int32_t coincidence_get_window_ns(void) { return s_window_ps / 1000; }
uint64_t coincidence_count(void) { return s_count; }

/* ── Portable core: try to form a coincidence from the two stamps ───────
 * Called whenever a new edge arrives on either channel.
 * Returns true and fills *out if a coincidence was detected.
 * Timestamps are in picoseconds.
 */
static bool try_coincidence(int64_t s0, int64_t s1, event_t *out)
{
    if (s0 < 0 || s1 < 0) return false;
    int64_t dt_ps = s1 - s0;
    int64_t adt = dt_ps < 0 ? -dt_ps : dt_ps;
    if (adt > (int64_t)s_window_ps) return false;

    /* Coincidence! Assemble the event */
    memset(out, 0, sizeof(*out));
    /* Δt in picoseconds (channel1 - channel0). Positive means bottom
     * tile fired after top → muon going downward (normal). */
    out->dt_ps = (int32_t)dt_ps;

    /* Read pulse heights from the ADS7946 (peak-hold triggered) */
    adc_trigger_and_read(&out->h0_mv, &out->h1_mv);

    s_count++;
    /* Reset stamps so we don't re-trigger on the same pair */
    s_stamp0_ps = -1;
    s_stamp1_ps = -1;
    return true;
}

/* ── Edge arrival hooks ─────────────────────────────────────────────────
 * Timestamps are in picoseconds since boot.
 */
void coincidence_on_edge0(int64_t ts_ps)
{
    s_stamp0_ps = ts_ps;
    event_t ev;
    if (try_coincidence(s_stamp0_ps, s_stamp1_ps, &ev))
        ring_push(&ev);
}

void coincidence_on_edge1(int64_t ts_ps)
{
    s_stamp1_ps = ts_ps;
    event_t ev;
    if (try_coincidence(s_stamp0_ps, s_stamp1_ps, &ev))
        ring_push(&ev);
}

void coincidence_init(void)
{
    s_stamp0_ps = -1;
    s_stamp1_ps = -1;
    s_count = 0;
    s_ring_head = s_ring_tail = 0;

#ifdef SKY_LENS_SIM
    port_sim_log("coincidence init (sim)");
#else
    /* Configure RMT RX channels on GPIO1 and GPIO2.
     * The RMT peripheral timestamps edges to 12.5 ns (80 MHz).
     * On each edge we call coincidence_on_edgeN with the timestamp.
     * Full RMT setup omitted here for brevity; the callback pattern
     * is: rmt_rx_event callbacks → coincidence_on_edge0/1.
     */
    ESP_LOGI(TAG, "coincidence init (RMT @ 80 MHz, window %ld ns)",
             (long)s_window_ns);
#endif
}

#include <math.h>
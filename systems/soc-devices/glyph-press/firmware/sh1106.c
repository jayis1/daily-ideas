/**
 * glyph_press/firmware/sh1106.c — SH1106 OLED Display Driver
 *
 * 128×64 monochrome OLED via I2C0 (GP7/GP8).
 * Simple text rendering with a 5×8 font + Braille dot preview.
 *
 * The OLED shows:
 *   Line 1: Mode, language, force setting
 *   Line 2: Emboss progress + paper status
 *   During emboss: a visual Braille dot preview of the current line
 */

#include "main.h"
#include "pico/stdlib.h"
#include "hardware/i2c.h"
#include <string.h>
#include <stdio.h>

#define OLED_ADDR    0x3C
#define OLED_WIDTH   128
#define OLED_HEIGHT  64

/* SH1106 commands */
#define SH1106_SET_CONTRAST     0x81
#define SH1106_DISPLAY_ON       0xAF
#define SH1106_DISPLAY_OFF      0xAE
#define SH1106_SET_PAGE_ADDR    0xB0
#define SH1106_SET_COL_LOW      0x00
#define SH1106_SET_COL_HIGH     0x10
#define SH1106_SET_SEG_REMAP    0xA0
#define SH1106_SET_COM_SCAN     0xC8
#define SH1106_SET_DISP_START   0x40

static bool s_init_done = false;

/* ── 5×8 font (printable ASCII subset) ────────────────────────────── */
static const uint8_t font5x8[][5] = {
    {0x00,0x00,0x00,0x00,0x00}, /* space */
    {0x00,0x00,0x5F,0x00,0x00}, /* ! */
    {0x00,0x07,0x00,0x07,0x00}, /* " */
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    {0x02,0x01,0x51,0x09,0x06}, /* ? */
    /* A-Z */
    {0x7E,0x11,0x11,0x11,0x7E},
    {0x7F,0x49,0x49,0x49,0x36},
    {0x7F,0x41,0x41,0x41,0x3E},
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    {0x61,0x51,0x49,0x45,0x43},
    /* a-z */
    {0x00,0x7F,0x41,0x41,0x00},
    {0x02,0x4F,0x51,0x51,0x3A},
    {0x36,0x49,0x49,0x49,0x36},
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    {0x61,0x51,0x49,0x45,0x43},
};

static uint8_t font_idx(char ch)
{
    if (ch == ' ') return 0;
    if (ch >= '!' && ch <= '?') return (uint8_t)(ch - '!' + 1);
    if (ch >= 'A' && ch <= 'Z') return (uint8_t)(ch - 'A' + 21);
    if (ch >= 'a' && ch <= 'z') return (uint8_t)(ch - 'a' + 47);
    return 0;
}

/* ── I2C helpers ──────────────────────────────────────────────────── */

static void oled_cmd(uint8_t cmd)
{
    uint8_t buf[2] = {0x00, cmd};
    i2c_write_blocking(i2c0, OLED_ADDR, buf, 2, false);
}

static void oled_data(uint8_t data)
{
    uint8_t buf[2] = {0x40, data};
    i2c_write_blocking(i2c0, OLED_ADDR, buf, 2, false);
}

/* ── Display buffer ───────────────────────────────────────────────── */

static uint8_t s_fb[OLED_HEIGHT / 8][OLED_WIDTH];

static void oled_flush(void)
{
    for (uint8_t page = 0; page < 8; page++) {
        oled_cmd(SH1106_SET_PAGE_ADDR | page);
        oled_cmd(SH1106_SET_COL_LOW | 0);
        oled_cmd(SH1106_SET_COL_HIGH | 0);
        for (uint8_t col = 0; col < OLED_WIDTH; col++)
            oled_data(s_fb[page][col]);
    }
}

/* ── Public functions ─────────────────────────────────────────────── */

void oled_init(void)
{
    i2c_init(i2c0, 400000);
    gpio_set_function(PIN_I2C_SDA, GPIO_FUNC_I2C);
    gpio_set_function(PIN_I2C_SCL, GPIO_FUNC_I2C);
    gpio_pull_up(PIN_I2C_SDA);
    gpio_pull_up(PIN_I2C_SCL);

    sleep_ms(50);
    oled_cmd(SH1106_DISPLAY_OFF);
    oled_cmd(0xD5); oled_cmd(0x80);  /* clock divide */
    oled_cmd(0xA8); oled_cmd(0x3F);  /* multiplex */
    oled_cmd(0xD3); oled_cmd(0x00);  /* display offset */
    oled_cmd(0x40);                   /* start line */
    oled_cmd(0x8D); oled_cmd(0x14);  /* charge pump */
    oled_cmd(0x20); oled_cmd(0x00);  /* page addressing */
    oled_cmd(0xA1);                   /* segment remap */
    oled_cmd(0xC8);                   /* COM scan direction */
    oled_cmd(0xDA); oled_cmd(0x12);  /* COM pins */
    oled_cmd(0x81); oled_cmd(0xCF);  /* contrast */
    oled_cmd(0xD9); oled_cmd(0xF1);  /* pre-charge */
    oled_cmd(0xDB); oled_cmd(0x40);  /* VCOM deselect */
    oled_cmd(0xA4);                   /* display RAM */
    oled_cmd(0xA6);                   /* normal display */
    oled_cmd(0xAF);                   /* display on */

    s_init_done = true;
    oled_clear();
}

void oled_clear(void)
{
    if (!s_init_done) return;
    memset(s_fb, 0, sizeof(s_fb));
    oled_flush();
}

void oled_text(uint8_t x, uint8_t y, const char *text)
{
    if (!s_init_done) return;
    uint8_t col = x;
    while (*text && col + 5 < OLED_WIDTH) {
        uint8_t idx = font_idx(*text);
        for (uint8_t i = 0; i < 5; i++) {
            uint8_t bits = font5x8[idx][i];
            if (y / 8 < 8 && col < OLED_WIDTH)
                s_fb[y / 8][col] = bits;
            col++;
        }
        col++; /* spacing */
        text++;
    }
    oled_flush();
}

void oled_braille_preview(uint8_t x, uint8_t y, const uint8_t *dots, uint16_t count)
{
    /* Draw each cell as a 2×4 grid of filled/empty dots */
    if (!s_init_done) return;
    for (uint16_t c = 0; c < count && x + c * 6 < OLED_WIDTH; c++) {
        uint8_t d = dots[c];
        for (uint8_t r = 0; r < 4; r++) {
            for (uint8_t col_d = 0; col_d < 2; col_d++) {
                uint8_t bit = r * 2 + col_d;
                bool on = (d >> bit) & 1;
                if (on) {
                    uint8_t px = x + c * 6 + col_d * 2;
                    uint8_t py = y + r * 2;
                    if (py / 8 < 8 && px < OLED_WIDTH) {
                        s_fb[py / 8][px]     |= (1 << (py % 8));
                        s_fb[py / 8][px + 1] |= (1 << (py % 8));
                        if (py + 1 < 64 && (py + 1) / 8 == py / 8)
                            s_fb[py / 8][px]     |= (1 << ((py % 8) + 1));
                    }
                }
            }
        }
    }
    oled_flush();
}

void oled_progress(uint8_t x, uint8_t y, uint8_t w, uint8_t pct)
{
    if (!s_init_done) return;
    uint8_t filled = (w * pct) / 100;
    for (uint8_t i = 0; i < w; i++) {
        if (y / 8 < 8 && x + i < OLED_WIDTH) {
            if (i < filled)
                s_fb[y / 8][x + i] = 0xFF;
            else
                s_fb[y / 8][x + i] = 0x81;
        }
    }
    oled_flush();
}

void oled_status(const char *line1, const char *line2)
{
    oled_clear();
    oled_text(0, 0,  line1);
    oled_text(0, 16, line2);
    if (g_config.cells_total > 0) {
        uint8_t pct = (uint8_t)((g_config.cells_done * 100) / g_config.cells_total);
        oled_progress(0, 32, 100, pct);
    }
}
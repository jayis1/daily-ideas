/**
 * glyph_press/firmware/feed.c — Paper Feed Stepper Driver
 *
 * NEMA8 stepper via TMC2209 driver, 3200 steps/rev (16 microsteps).
 * Drives a knurled feed roller to advance paper/label tape.
 *
 * Step pulses are generated by bit-banging GP9 (PIO could also be used
 * for precise timing, but bit-bang is sufficient at these low speeds).
 *
 * Feed distances:
 *   One cell:  6 mm  → ~53 steps
 *   One line:  10 mm  → ~88 steps
 */

#include "main.h"
#include "pico/stdlib.h"
#include "hardware/gpio.h"

#define STEP_DELAY_US  800  /* ~1250 steps/sec max */
#define ACCEL_RAMP     50   /* steps to ramp up/down */

static bool s_init_done = false;

void feed_init(void)
{
    gpio_init(PIN_STEP_STEP);
    gpio_set_dir(PIN_STEP_STEP, GPIO_OUT);
    gpio_put(PIN_STEP_STEP, 0);

    gpio_init(PIN_STEP_DIR);
    gpio_set_dir(PIN_STEP_DIR, GPIO_OUT);

    gpio_init(PIN_STEP_EN);
    gpio_set_dir(PIN_STEP_EN, GPIO_OUT);
    gpio_put(PIN_STEP_EN, 1); /* disabled (active low) */

    s_init_done = true;
}

static void step_pulse(uint32_t delay_us)
{
    gpio_put(PIN_STEP_STEP, 1);
    sleep_us(delay_us);
    gpio_put(PIN_STEP_STEP, 0);
    sleep_us(delay_us);
}

static void feed_steps(uint32_t steps, bool forward)
{
    if (!s_init_done || steps == 0) {
        g_feed_done = true;
        return;
    }

    /* Enable driver */
    gpio_put(PIN_STEP_EN, 0);
    gpio_put(PIN_STEP_DIR, forward ? 1 : 0);
    sleep_us(10);

    /* Acceleration ramp */
    for (uint32_t i = 0; i < steps; i++) {
        uint32_t delay = STEP_DELAY_US;
        if (i < ACCEL_RAMP)
            delay = STEP_DELAY_US + (ACCEL_RAMP - i) * 4;
        else if (i > steps - ACCEL_RAMP)
            delay = STEP_DELAY_US + (i - (steps - ACCEL_RAMP)) * 4;
        step_pulse(delay);
    }

    /* Disable driver */
    gpio_put(PIN_STEP_EN, 1);
    g_feed_done = true;
}

void feed_cell(void)
{
    g_feed_done = false;
    feed_steps(STEPS_PER_CELL, true);
}

void feed_line(void)
{
    g_feed_done = false;
    /* Feed forward by one line height, then the carriage stays in place
     * (the emboss head is fixed; the paper moves). */
    feed_steps(STEPS_PER_LINE, true);
}

void feed_mm(float mm)
{
    g_feed_done = false;
    uint32_t steps = (uint32_t)(mm * STEPS_PER_MM);
    feed_steps(steps, true);
}

void feed_wait(void)
{
    /* Blocking wait handled in feed_steps; this is a no-op placeholder */
}
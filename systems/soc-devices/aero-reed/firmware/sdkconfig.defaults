## systems/soc-devices/aero-reed/firmware/sdkconfig.defaults
```kconfig
# Aero Reed — ESP-IDF sdkconfig defaults
# Target: ESP32-S3-WROOM-1-N8

# CPU / Flash
CONFIG_IDF_TARGET="esp32s3"
CONFIG_ESPTOOLPY_FLASHMODE_QIO=y
CONFIG_ESPTOOLPY_FLASHFREQ_80M=y
CONFIG_ESPTOOLPY_FLASHSIZE_8MB=y
CONFIG_ESP_DEFAULT_CPU_FREQ_MHZ_240=y
CONFIG_ESP_MAIN_TASK_STACK_SIZE=8192

# FreeRTOS
CONFIG_FREERTOS_HZ=1000
CONFIG_FREERTOS_ENABLE_BACKWARD_COMPATIBILITY=y

# I2S
CONFIG_SOC_I2S_NUM=1
CONFIG_SOC_I2S_SUPPORTS_TX=y

# Bluetooth (BLE MIDI)
CONFIG_BT_ENABLED=y
CONFIG_BT_NIMBLE_ENABLED=y
CONFIG_BT_NIMBLE_ROLE_PERIPHERAL=y
CONFIG_BT_NIMBLE_MAX_CONNECTIONS=1
CONFIG_BT_NIMBLE_NVS_PERSIST=y
CONFIG_BT_NIMBLE_SM_LEGACY=y
CONFIG_BT_NIMBLE_SM_SC=y

# USB (TinyUSB for USB MIDI)
CONFIG_TINYUSB_TASK_STACK=4096

# Partition table (NVS for patches)
CONFIG_PARTITION_TABLE_SINGLE_APP=y

# Logging
CONFIG_LOG_DEFAULT_LEVEL_INFO=y
CONFIG_LOG_MAXIMUM_LEVEL_DEBUG=y

# SPI
CONFIG_SPI_MASTER_IN_IRAM=y

# ADC
CONFIG_ADC_ONESHOT_SOFT_FALLBACK_MODE=y

# I2C
CONFIG_I2C_ENABLE_DEBUG_LOG=n
```

## systems/soc-devices/bolt-compass/firmware/sdkconfig.defaults
```kconfig
# Bolt Compass — ESP32-S3 sdkconfig defaults
#
# Stack: ESP-IDF v5.2, ESP32-S3-WROOM-1 (N16R8 = 16 MB flash, 8 MB octal PSRAM)

# --- Target ---
CONFIG_IDF_TARGET="esp32s3"

# --- Flash / PSRAM ---
CONFIG_ESPTOOLPY_FLASHSIZE_16MB=y
CONFIG_ESPTOOLPY_FLASHSIZE="16MB"
CONFIG_SPIRAM=y
CONFIG_SPIRAM_MODE_OCTAL=y
CONFIG_SPIRAM_SPEED_80M=y
CONFIG_SPIRAM_USE_MALLOC=y
CONFIG_SPIRAM_MALLOC_ALWAYSINTERNAL=16384

# --- CPU ---
CONFIG_ESP_DEFAULT_CPU_FREQ_MHZ_240=y

# --- FreeRTOS ---
CONFIG_FREERTOS_HZ=100
CONFIG_FREERTOS_ENABLE_BACKWARD_COMPATIBILITY=y

# --- Wi-Fi ---
CONFIG_ESP_WIFI_ENABLED=y
CONFIG_ESP_WIFI_MODE_APSTA=y
CONFIG_ESP_WIFI_AP_NUM=1

# --- BLE (NimBLE) ---
CONFIG_BT_ENABLED=y
CONFIG_BT_NIMBLE_ENABLED=y
CONFIG_BT_NIMBLE_MAX_CONNECTIONS=1
CONFIG_BT_NIMBLE_ROLE_PERIPHERAL=y
CONFIG_BT_NIMBLE_ROLE_BROADCASTER=y

# --- FatFS / SD ---
CONFIG_FATFS_LFN_ENABLE=y
CONFIG_FATFS_CODEPAGE_437=y

# --- mDNS ---
CONFIG_MDNS_ENABLED=y

# --- Light sleep ---
CONFIG_FREERTOS_USE_TICKLESS_IDLE=y
CONFIG_ESP_SLEEP_ENABLE_RAM_SPI_DEEP_SLEEP=y

# --- Logging ---
CONFIG_LOG_DEFAULT_LEVEL_INFO=y
CONFIG_LOG_MAXIMUM_LEVEL_DEBUG=y
```

## systems/soc-devices/dent-scope/firmware/esp32-c3/sdkconfig.defaults
```kconfig
# dent-scope / firmware/esp32-c3/sdkconfig.defaults
# ESP32-C3 default config for Dent Scope uplink
# MIT License
CONFIG_IDF_TARGET="esp32c3"
CONFIG_ESP_CONSOLE_UART=y
CONFIG_ESP_CONSOLE_UART_NUM=1
CONFIG_BT_ENABLED=y
CONFIG_BT_NIMBLE_ENABLED=y
CONFIG_BT_NIMBLE_MAX_CONNECTIONS=1
CONFIG_BT_NIMBLE_MAX_BONDS=4
CONFIG_BT_NIMBLE_ROLE_PERIPHERAL=y
CONFIG_BT_NIMBLE_ROLE_BROADCASTER=y
CONFIG_BT_NIMBLE_SM_LEGACY=n
CONFIG_BT_NIMBLE_SM_SC=y
CONFIG_BT_NIMBLE_HOST_TASK_STACK_SIZE=4096
CONFIG_WIFI_ENABLED=y
CONFIG_ESP_WIFI_MODE_AP=y
CONFIG_ESP_WIFI_SOFTAP_MAX_CONN=4
CONFIG_LWIP_MAX_SOCKETS=8
CONFIG_FREERTOS_HZ=1000
CONFIG_PARTITION_TABLE_SINGLE_APP=y
```

## systems/soc-devices/echo-mote/firmware/sdkconfig.defaults
```kconfig
# Echo Mote sdkconfig defaults
# ESP32-S3-WROOM-1-N8R8

# Target
CONFIG_IDF_TARGET="esp32s3"

# PSRAM (8MB on WROOM-1-N8R8)
CONFIG_SPIRAM=y
CONFIG_SPIRAM_MODE_OCT=y
CONFIG_SPIRAM_SPEED_80M=y
CONFIG_SPIRAM_USE_MALLOC=y
CONFIG_SPIRAM_MALLOC_ALWAYSINTERNAL=16384
CONFIG_SPIRAM_MALLOC_RESERVE_INTERNAL=32768

# I2S
CONFIG_I2S_ENABLE_DEBUG_LOG=n

# Bluetooth BLE
CONFIG_BT_ENABLED=y
CONFIG_BTDM_CTRL_MODE_BLE_ONLY=y
CONFIG_BT_BLE_ENABLED=y
CONFIG_BT_GATTS_ENABLE=y

# Wi-Fi
CONFIG_ESP_WIFI_ENABLED=y

# FreeRTOS
CONFIG_FREERTOS_HZ=1000

# Main task stack
CONFIG_ESP_MAIN_TASK_STACK_SIZE=8192

# Flash
CONFIG_ESPTOOLPY_FLASHSIZE_8MB=y
CONFIG_ESPTOOLPY_FLASHMODE_QIO=y

# Optimization
CONFIG_COMPILER_OPTIMIZATION_PERF=y

# Watchdog
CONFIG_ESP_TASK_WDT=n

# HTTP server (for Wi-Fi API)
CONFIG_ESP_HTTP_SERVER=y
```

## systems/soc-devices/echo-trap/firmware/sdkconfig.defaults
```kconfig
# Echo Trap — ESP32-S3 sdkconfig defaults
# Target: ESP32-S3-WROOM-1-N8R8

# Target chip
CONFIG_IDF_TARGET="esp32s3"

# Flash / PSRAM
CONFIG_ESPTOOLPY_FLASHSIZE_8MB=y
CONFIG_ESPTOOLPY_FLASHSIZE="8MB"
CONFIG_SPIRAM_USE_MALLOC=y
CONFIG_SPIRAM_TYPE_AUTO=y
CONFIG_SPIRAM_SPEED_80M=y
CONFIG_SPIRAM_BOOT_INIT=y

# FreeRTOS
CONFIG_FREERTOS_HZ=1000
CONFIG_FREERTOS_ENABLE_BACKWARD_COMPATIBILITY=y

# Partition table (custom: nvs + app + nvs_keys)
CONFIG_PARTITION_TABLE_CUSTOM=y
CONFIG_PARTITION_TABLE_FILENAME="partitions.csv"

# I2S
CONFIG_SOC_I2S_SUPPORTS_ADC=y

# BLE (for provisioning)
CONFIG_BT_ENABLED=y
CONFIG_BT_BLE_42_FEATURES_SUPPORTED=y
CONFIG_BT_NIMBLE_ENABLED=y
CONFIG_BT_NIMBLE_MAX_CONNECTIONS=1

# LoRa (no special config needed — SPI driver based)

# Power management
CONFIG_PM_ENABLE=y
CONFIG_FREERTOS_USE_TICKLESS_IDLE=y
CONFIG_PM_DFS_INIT_AUTO=y

# Log level
CONFIG_LOG_DEFAULT_LEVEL_INFO=y

# Watchdog
CONFIG_ESP_TASK_WDT_TIMEOUT_S=10
```

## systems/soc-devices/ferro-weave/firmware/esp32/main/sdkconfig.defaults
```kconfig
# Ferro Weave ESP32-C3 sdkconfig defaults
CONFIG_IDF_TARGET="esp32c3"
CONFIG_IDF_TARGET_ESP32C3=y

# CPU
CONFIG_ESP_DEFAULT_CPU_FREQ_MHZ_160=y

# BLE (NimBLE)
CONFIG_BT_ENABLED=y
CONFIG_BT_NIMBLE_ENABLED=y
CONFIG_BT_NIMBLE_ROLE_PERIPHERAL=y
CONFIG_BT_NIMBLE_ROLE_BROADCASTER=y
CONFIG_BT_NIMBLE_MAX_CONNECTIONS=1
CONFIG_BT_NIMBLE_MAX_BONDS=0
CONFIG_BT_NIMBLE_NVS_PERSIST=y
CONFIG_BT_NIMBLE_TASK_STACK_SIZE=4096

# Wi-Fi
CONFIG_ESP_WIFI_ENABLED=y
CONFIG_ESP_WIFI_MODE_APSTA=y
CONFIG_ESP_WIFI_AP_MAX_CONNECTIONS=4
CONFIG_ESP_WIFI_STA_DISCONNECT_ON_PM=y

# mDNS
CONFIG_MDNS_ENABLED=y

# Partition table — custom for NVS + app
CONFIG_PARTITION_TABLE_CUSTOM=y
CONFIG_PARTITION_TABLE_FILENAME="partitions.csv"

# FreeRTOS
CONFIG_FREERTOS_HZ=1000

# Logging
CONFIG_LOG_DEFAULT_LEVEL_INFO=y
```

## systems/soc-devices/flux-ring/firmware/sdkconfig.defaults
```kconfig
# Flux Ring — sdkconfig.defaults (nRF Connect SDK / Zephyr)
# Target: nRF52840

CONFIG_SOC_SERIES_NRF52X=y
CONFIG_SOC_NRF52840_QIAA=y
CONFIG_BOARD_NRF52840DK_NRF52840=y

# Clock
CONFIG_CLOCK_CONTROL_NRF=y
CONFIG_CLOCK_CONTROL_NRF_K32SRC_XTAL=y

# Bluetooth
CONFIG_BT=y
CONFIG_BT_PERIPHERAL=y
CONFIG_BT_DEVICE_NAME="Flux Ring"
CONFIG_BT_DEVICE_NAME_DYNAMIC=y
CONFIG_BT_MAX_CONN=1
CONFIG_BT_GATT_DYNAMIC=y

# BLE Long Range (optional)
CONFIG_BT_CTLR_ADV_EXT=y

# I2C
CONFIG_I2C=y
CONFIG_I2C_NRFX=y

# SPI (for flash logger)
CONFIG_SPI=y

# GPIO
CONFIG_GPIO=y

# ADC (battery voltage)
CONFIG_ADC=y

# Logging
CONFIG_LOG=y
CONFIG_LOG_DEFAULT_LEVEL=3
CONFIG_LOG_BACKEND_UART=y

# UART
CONFIG_UART_CONSOLE=y
CONFIG_SERIAL=y

# Power management
CONFIG_PM=y
CONFIG_PM_DEVICE=y

# Threading
CONFIG_MULTITHREADING=y
CONFIG_NUM_COOP_PRIORITIES=16
CONFIG_NUM_PREEMPT_PRIORITIES=16

# Stack sizes
CONFIG_MAIN_STACK_SIZE=2048
CONFIG_SYSTEM_WORKQUEUE_STACK_SIZE=1024

# Heap
CONFIG_HEAP_MEM_POOL_SIZE=1024

# Float/Double (needed for field calculations)
CONFIG_FPU=y
CONFIG_NEWLIB_LIBC=y
CONFIG_NEWLIB_LIBC_FLOAT_PRINTF=y
```

## systems/soc-devices/phyto-pulse/firmware/esp32-c3/sdkconfig.defaults
```kconfig
# sdkconfig.defaults — ESP32-C3 for Phyto Pulse
# BLE + Wi-Fi AP mode enabled

CONFIG_IDF_TARGET="esp32c3"
CONFIG_BT_ENABLED=y
CONFIG_BT_NIMBLE_ENABLED=y
CONFIG_BT_NIMBLE_ROLE_PERIPHERAL=y
CONFIG_BT_NIMBLE_ROLE_BROADCASTER=y
CONFIG_BT_NIMBLE_HOST_TASK_STACK_SIZE=4096
CONFIG_BT_NIMBLE_NVS_PERSIST=y

CONFIG_ESP_WIFI_ENABLED=y
CONFIG_ESP_WIFI_SOFTAP_SUPPORT=y
CONFIG_ESP_WIFI_STA_SUPPORT=n

CONFIG_ESP_MAIN_TASK_STACK_SIZE=4096
CONFIG_FREERTOS_HZ=1000

CONFIG_ESPTOOLPY_FLASHSIZE_4MB=y
CONFIG_PARTITION_TABLE_SINGLE_APP=y

CONFIG_ESP_SYSTEM_MEMPROT_FEATURE=y
CONFIG_ESP_SYSTEM_PANIC_PRINT_REBOOT=y
```

## systems/soc-devices/ping-caliper/firmware/esp32c3/sdkconfig.defaults
```kconfig
# Ping Caliper — ESP32-C3 SDK configuration
# Overrides applied on top of ESP-IDF defaults (sdkconfig.defaults).

# BLE
CONFIG_BT_ENABLED=y
CONFIG_BT_NIMBLE_ENABLED=y
CONFIG_BT_NIMBLE_MAX_CONNECTIONS=2
CONFIG_BT_NIMBLE_MAX_BONDS=4
CONFIG_BT_NIMBLE_HOST_TASK_STACK_SIZE=4096
CONFIG_BT_NIMBLE_NVS_PERSIST=y

# Wi-Fi
CONFIG_ESP_WIFI_ENABLED=y
CONFIG_ESP_WIFI_MODE_NOSL=n
CONFIG_ESP_WIFI_STA_MODE=y
CONFIG_ESP_WIFI_AP_MODE=y
CONFIG_ESP_WIFI_SOFTAP_MAX_CONNECT=4

# Partition table — OTA-enabled (two app slots)
CONFIG_PARTITION_TABLE_CUSTOM=y
CONFIG_PARTITION_TABLE_FILENAME="partitions.csv"

# FreeRTOS
CONFIG_FREERTOS_HZ=1000
CONFIG_FREERTOS_TASK_STACK_OVERHEAD=256

# UART
CONFIG_UART_ISR_IRAM_SAFE=y

# Flash — 4 MB module, 2 OTA slots
CONFIG_ESPTOOLPY_FLASHSIZE_4MB=y
CONFIG_ESPTOOLPY_FLASHMODE_DIO=y
CONFIG_ESPTOOLPY_FLASHFREQ_40M=y

# Logging
CONFIG_LOG_DEFAULT_LEVEL_INFO=y

# Power
CONFIG_PM_ENABLE=y
CONFIG_PM_LIGHTSLEEP_DEFAULT_ENABLE=y
```

## systems/soc-devices/pyro-balance/firmware/esp32-c3/sdkconfig.defaults
```kconfig
# Pyro Balance ESP32-C3 sdkconfig defaults
CONFIG_IDF_TARGET="esp32c3"
CONFIG_BT_ENABLED=y
CONFIG_BT_NIMBLE_ENABLED=n
CONFIG_BT_BLUEDROID_ENABLED=y
CONFIG_BT_BLE_ENABLED=y
CONFIG_WIFI_ENABLED=y
CONFIG_ESP_WIFI_AP=y
CONFIG_ESP_WIFI_STA=n
```

## systems/soc-devices/quartz-tuner/firmware/sdkconfig.defaults
```kconfig
# Quartz Tuner — sdkconfig defaults (mapped to STM32 HAL defines)
#
# STM32G491RET6 @ 170 MHz, 512 KB flash, 128 KB SRAM
# HSI16 + PLL: 16 MHz × 10.625 = 170 MHz system clock
# I2C1 @ 400 kHz (Si5351A + AD5933 + OLED + MAX17048)
# SPI1 @ 25 MHz (microSD)
# TIM2 + TIM3 for frequency counter
# TIM8 CH2 for heater PWM
# USART2 @ 115200 (debug, USB-CDC alternate)
# USB CDC device
# FatFs on SPI SD card
# FreeRTOS tick 100 Hz

CONFIG_STM32G491=y
CONFIG_SYSCLK_170MHZ=y
CONFIG_HSI16_PLL=y
CONFIG_I2C1_400KHZ=y
CONFIG_SPI1_25MHZ=y
CONFIG_USART2_115200=y
CONFIG_USB_CDC=y
CONFIG_FATFS_SD=y
CONFIG_FREERTOS_100HZ=y
CONFIG_CORTEX_M4_FPU=y
```

## systems/soc-devices/refracto-bead/firmware/esp32-c3/sdkconfig.defaults
```kconfig
# Refracto Bead ESP32-C3 sdkconfig defaults

# Target
CONFIG_IDF_TARGET="esp32c3"

# Bluetooth BLE
CONFIG_BT_ENABLED=y
CONFIG_BTDM_CTRL_MODE_BLE_ONLY=y
CONFIG_BT_BLE_ENABLED=y
CONFIG_BT_GATTS_ENABLE=y

# Wi-Fi
CONFIG_ESP_WIFI_ENABLED=y

# FreeRTOS
CONFIG_FREERTOS_HZ=1000

# Main task stack
CONFIG_ESP_MAIN_TASK_STACK_SIZE=8192

# Flash
CONFIG_ESPTOOLPY_FLASHSIZE_4MB=y

# UART (receive from STM32 @ 460800)
CONFIG_UART_ISR_IRAM_SAFE=y

# HTTP server
CONFIG_ESP_HTTP_SERVER=y

# Optimization
CONFIG_COMPILER_OPTIMIZATION_PERF=y

# Watchdog
CONFIG_ESP_TASK_WDT=n
```

## systems/soc-devices/scribe-nib/firmware/sdkconfig.defaults
```kconfig
# Scribe Nib — ESP32-S3 SDK configuration defaults

# Target
CONFIG_IDF_TARGET="esp32s3"

# CPU frequency
CONFIG_ESP32S3_DEFAULT_CPU_FREQ_240=y

# FreeRTOS
CONFIG_FREERTOS_HZ=1000

# BLE
CONFIG_BT_ENABLED=y
CONFIG_BTDM_CTRL_MODE_BLE_ONLY=y
CONFIG_BT_BLE_ENABLED=y
CONFIG_BTDM_MODEM_SLEEP=y
CONFIG_BLE_HID_ENABLED=y

# Power management
CONFIG_PM_ENABLE=y
CONFIG_PM_DFS_INIT_AUTO=y
CONFIG_PM_PROFILING=y

# SPI
CONFIG_SPI_MASTER_ISR_IN_IRAM=y

# I2C
CONFIG_I2C_ENABLE_DEBUG_LOG=n

# Touch
CONFIG_TOUCH_PAD_ISR_IN_IRAM=y

# Deep sleep
CONFIG_ESP32S3_DEEP_SLEEP_WAKEUP_DELAY=2000

# Flash
CONFIG_ESPTOOLPY_FLASHSIZE_8MB=y
CONFIG_ESPTOOLPY_FLASHMODE_DIO=y
CONFIG_ESPTOOLPY_FLASHFREQ_80M=y

# PSRAM (not used — keep disabled for power savings)
CONFIG_ESP32S3_SPIRAM_SUPPORT=n

# UART
CONFIG_UART_ISR_IN_IRAM=y

# LEDC (PWM for vibration motor)
CONFIG_LEDC_ENABLE_DEBUG_LOG=n

# Watchdog — disable for development
CONFIG_ESP_TASK_WDT=n

# Optimization
CONFIG_COMPILER_OPTIMIZATION_SIZE=y
CONFIG_COMPILER_OPTIMIZATION_ASSERTIONS_SILENT=y

# NVS
CONFIG_NVS_ENCRYPTION=n

# OTA (future)
CONFIG_ESP_HTTPS_OTA_DECRYPT_CB=n
```

## systems/soc-devices/sky-lens/firmware/esp32/main/sdkconfig.defaults
```kconfig
# Sky Lens — ESP32-S3 sdkconfig defaults
# ESP-IDF v5.2

# Target
CONFIG_IDF_TARGET="esp32s3"

# CPU frequency
CONFIG_ESP_DEFAULT_CPU_FREQ_MHZ_240=y

# FreeRTOS
CONFIG_FREERTOS_HZ=1000

# Wi-Fi
CONFIG_ESP_WIFI_STA=y
CONFIG_ESP_WIFI_SOFTAP=y
CONFIG_ESP_WIFI_AP_NUM=1

# BLE (NimBLE)
CONFIG_BT_ENABLED=y
CONFIG_BT_NIMBLE_ENABLED=y
CONFIG_BT_NIMBLE_MAX_CONNECTIONS=1
CONFIG_BT_NIMBLE_HOST_TASK_STACK_SIZE=4096

# FatFS
CONFIG_FATFS_CODEPAGE_850=y
CONFIG_FATFS_LFN_STACK=y
CONFIG_FATFS_MAX_LFN=127

# I²C
CONFIG_I2C_MASTER_TIMEOUT_MS=100

# SPI
CONFIG_SPI_MASTER_IN_IRAM=y

# PSRAM (ESP32-S3-WROOM-1 with 8 MB PSRAM)
CONFIG_SPIRAM=y
CONFIG_SPIRAM_USE_MALLOC=y
CONFIG_SPIRAM_TYPE_ESPPSRAM64=y

# Partition table (custom: 4 MB flash, 16 MB optional)
CONFIG_PARTITION_TABLE_CUSTOM=y
CONFIG_PARTITION_TABLE_CUSTOM_FILENAME="partitions.csv"

# NVS
CONFIG_NVS_ENCRYPTION=n

# Logging
CONFIG_LOG_DEFAULT_LEVEL_INFO=y
CONFIG_LOG_MAXIMUM_LEVEL_DEBUG=y

# mDNS
CONFIG_MDNS_ENABLED=y
```

## systems/soc-devices/terra-pin/firmware/sdkconfig.defaults
```kconfig
# terra_pin/firmware/sdkconfig.defaults
# ESP-IDF v5.2 default configuration for Terra Pin
# These are applied on top of the default sdkconfig for ESP32-S3.

# ── Target ──────────────────────────────────────────────────────────
CONFIG_IDF_TARGET="esp32s3"

# ── Flash / Partition ───────────────────────────────────────────────
CONFIG_ESPTOOLPY_FLASHSIZE_8MB=y
CONFIG_ESPTOOLPY_FLASHMODE_DIO=y
CONFIG_PARTITION_TABLE_SINGLE_APP=y

# ── FreeRTOS ────────────────────────────────────────────────────────
CONFIG_FREERTOS_HZ=1000
CONFIG_FREERTOS_ENABLE_TASK_SNAPSHOT=y

# ── Bluetooth ───────────────────────────────────────────────────────
CONFIG_BT_ENABLED=y
CONFIG_BT_BLUEDROID_ENABLED=y
CONFIG_BT_NIMBLE_ENABLED=n
CONFIG_BT_BLE_ENABLED=y
CONFIG_BT_GATTS_ENABLE=y
CONFIG_BT_BLE_42_FEATURES_SUPPORTED=y
CONFIG_BT_CTRL_SCAN_DUPLICATE=y

# ── I2C ─────────────────────────────────────────────────────────────
CONFIG_I2C_ENABLE_DEBUG_LOG=n

# ── SD card / FATFS ─────────────────────────────────────────────────
CONFIG_FATFS_CODEPAGE_850=y
CONFIG_FATFS_LFN_STACK=y
CONFIG_FATFS_MAX_LFN=127

# ── SPI ─────────────────────────────────────────────────────────────
CONFIG_SPI_MASTER_IN_IRAM=y

# ── LED Strip (RMT) ─────────────────────────────────────────────────
CONFIG_RMT_TX_ENABLE=y

# ── NVS ─────────────────────────────────────────────────────────────
CONFIG_NVS_ENCRYPTION=n

# ── Power management ────────────────────────────────────────────────
CONFIG_PM_ENABLE=y
CONFIG_FREERTOS_USE_TICKLESS_IDLE=y
CONFIG_PM_POWER_DOWN_CPU=y

# ── Logging ─────────────────────────────────────────────────────────
CONFIG_LOG_DEFAULT_LEVEL_INFO=y
CONFIG_LOG_COLORS=y

# ── Wi-Fi (optional, for future CSV push / OTA) ─────────────────────
CONFIG_ESP_WIFI_ENABLED=y
CONFIG_ESP_WIFI_NVS_ENABLED=y
```

## systems/soc-devices/therma-weave/firmware/sdkconfig.defaults
```kconfig
# Therma Weave — ESP32-C3 sdkconfig defaults
# Optimized for low power and BLE operation

# Target
CONFIG_IDF_TARGET="esp32c3"

# BLE configuration
CONFIG_BT_ENABLED=y
CONFIG_BTDM_CTRL_MODE_BLE_ONLY=y
CONFIG_BT_BLE_ENABLED=y
CONFIG_BT_GATTS_ENABLE=y
CONFIG_BT_BLE_RPA_ENABLED=y
CONFIG_BT_BLE_42_FEATURES_SUPPORTED=y

# Power management
CONFIG_PM_ENABLE=y
CONFIG_PM_DFS_INIT_AUTO=y
CONFIG_FREERTOS_USE_TICKLESS_IDLE=y

# WiFi (disabled — we only use BLE)
CONFIG_ESP_WIFI_ENABLED=n

# CPU frequency
CONFIG_ESP32C3_DEFAULT_CPU_FREQ_160=y
CONFIG_ESP32C3_DEFAULT_CPU_FREQ=160

# Flash size
CONFIG_ESPTOOLPY_FLASHSIZE_4MB=y
CONFIG_ESPTOOLPY_FLASHSIZE="4MB"

# Log level
CONFIG_LOG_DEFAULT_LEVEL_INFO=y
CONFIG_LOG_DEFAULT_LEVEL=3

# FreeRTOS
CONFIG_FREERTOS_HZ=1000

# NVS
CONFIG_PARTITION_TABLE_CUSTOM=y
CONFIG_PARTITION_TABLE_CUSTOM_FILENAME="partitions.csv"

# Brownout detector
CONFIG_ESP32C3_BROWNOUT_DET=y
CONFIG_ESP32C3_BROWNOUT_DET_LVL=7

# Watchdog
CONFIG_ESP_TASK_WDT=y
CONFIG_ESP_TASK_WDT_TIMEOUT_S=10
```

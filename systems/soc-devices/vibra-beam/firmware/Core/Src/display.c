/*
 * display.c — SH1106 OLED UI for Vibra Beam
 *
 * Pages: boot, idle, menu, live measure (waveform + spectrum),
 *        result, lissajous (I/Q circle), audio, fault.
 */

#include "display.h"
#include "i2c_util.h"
#include "config.h"
#include <string.h>
#include <stdio.h>
#include <math.h>

#define OLED_ADDR CONFIG_OLED_I2C_ADDR
#define W CONFIG_OLED_WIDTH
#define H CONFIG_OLED_HEIGHT

static uint8_t buf[W * H / 8];

/* ── Low-level I2C framebuffer write ────────────────────── */
static void oled_flush(void)
{
    /* SH1106: page-addressed, 8 pages of 128 bytes */
    for (uint8_t p = 0; p < 8; p++) {
        uint8_t cmd[4] = {
            0x00,                       /* control byte = command */
            (uint8_t)(0xB0 + p),        /* page address */
            0x00,                       /* lower column nibble */
            0x10                        /* upper column nibble */
        };
        i2c_write(OLED_ADDR, cmd, 4);
        uint8_t data[1 + W];
        data[0] = 0x40;  /* data control byte */
        memcpy(data + 1, &buf[p * W], W);
        i2c_write(OLED_ADDR, data, 1 + W);
    }
}

static void oled_clear(void) { memset(buf, 0, sizeof(buf)); }

static void oled_set_px(int x, int y, int on)
{
    if (x < 0 || x >= W || y < 0 || y >= H) return;
    if (on) buf[x + (y / 8) * W] |=  (1 << (y & 7));
    else    buf[x + (y / 8) * W] &= ~(1 << (y & 7));
}

static void oled_text(int x, int y, const char *s)
{
    /* 5x7 font columns starting at (x,y) */
    extern const uint8_t font5x7[][5];
    int cx = x;
    for (const char *p = s; *p && cx < W - 5; p++, cx += 6) {
        const uint8_t *g = font5x7[(uint8_t)*p - 0x20];
        for (int i = 0; i < 5; i++) {
            for (int j = 0; j < 7; j++) {
                oled_set_px(cx + i, y + j, (g[i] >> j) & 1);
            }
        }
    }
}

static void oled_hline(int x0, int x1, int y)
{
    for (int x = x0; x <= x1; x++) oled_set_px(x, y, 1);
}

static void oled_vline(int x, int y0, int y1)
{
    for (int y = y0; y <= y1; y++) oled_set_px(x, y, 1);
}

/* ── Public API ─────────────────────────────────────────── */
void display_init(void)
{
    /* SH1106 init sequence */
    static const uint8_t init[] = {
        0xAE, 0xD5, 0x80, 0xA8, 0x3F, 0xD3, 0x00, 0x40,
        0x8D, 0x14, 0xA1, 0xC8, 0xDA, 0x12, 0xD9, 0xF1,
        0xDB, 0x40, 0xA4, 0xA6, 0xAF
    };
    uint8_t cmd[1 + sizeof(init)];
    cmd[0] = 0x00;
    memcpy(cmd + 1, init, sizeof(init));
    i2c_write(OLED_ADDR, cmd, sizeof(cmd));
    oled_clear();
    oled_flush();
}

void display_boot(const char *msg)
{
    oled_clear();
    oled_text(0, 0, "Vibra Beam");
    oled_text(0, 12, msg);
    oled_flush();
}

void display_idle(float temp_c, float vbat_mv, float laser_mw)
{
    char line[24];
    oled_clear();
    oled_text(0, 0, "Vibra Beam");
    snprintf(line, sizeof(line), "T:%.1fC  V:%.0fmV", temp_c, vbat_mv);
    oled_text(0, 12, line);
    snprintf(line, sizeof(line), "Laser: %.1fmW", laser_mw);
    oled_text(0, 24, line);
    oled_text(0, 40, "A=menu  B=sel");
    oled_text(0, 52, "Aim at target");
    oled_flush();
}

void display_menu(uint8_t item)
{
    char line[24];
    oled_clear();
    oled_text(0, 0, "== Menu ==");
    extern const char *menu_items[];
    extern uint8_t menu_item;
    (void)item;
    /* Show 5 items starting near current */
    for (int i = 0; i < 5; i++) {
        int idx = (menu_item + i) % 10;
        snprintf(line, sizeof(line), "%c %s", (i == 0) ? '>' : ' ', menu_items[idx]);
        oled_text(0, 12 + i * 10, line);
    }
    oled_flush();
}

void display_measure_live(const phase_block_t *pb, const fft_result_t *fft)
{
    char line[24];
    oled_clear();
    oled_text(0, 0, "MEAS");
    /* Plot velocity waveform (bottom half) */
    float vmax = 1e-6f;
    for (uint32_t i = 0; i < pb->n && i < W; i++) {
        float a = fabsf(pb->vel_mms[i]);
        if (a > vmax) vmax = a;
    }
    for (uint32_t i = 0; i < pb->n && i < W; i++) {
        int y = 32 - (int)((pb->vel_mms[i] / vmax) * 24.0f);
        oled_set_px(i, y, 1);
    }
    /* Mid line */
    oled_hline(0, W - 1, 32);
    /* Summary line */
    snprintf(line, sizeof(line), "v=%.2fmm/s", vmax);
    oled_text(0, 52, line);
    oled_flush();
    (void)fft;
}

void display_result(const measure_result_t *r)
{
    char line[24];
    oled_clear();
    oled_text(0, 0, "== Result ==");
    snprintf(line, sizeof(line), "Disp:%.1fnm", r->displacement_nm);
    oled_text(0, 12, line);
    snprintf(line, sizeof(line), "Vpk:%.2fmm/s", r->velocity_mms);
    oled_text(0, 24, line);
    snprintf(line, sizeof(line), "Vrms:%.2fmm/s", r->rms_velocity_mms);
    oled_text(0, 36, line);
    snprintf(line, sizeof(line), "f:%.1fHz THD:%.1f%%", r->freq_peak_hz, r->thd_pct);
    oled_text(0, 48, line);
    oled_text(0, 56, "A=back");
    oled_flush();
}

void display_lissajous(const iq_block_t *iq)
{
    oled_clear();
    oled_text(0, 0, "Lissajous I/Q");
    /* Plot I vs Q in 64x64 box centered */
    int cx = W / 2, cy = H / 2 + 8;
    for (uint32_t i = 0; i < iq->n; i++) {
        int x = cx + (iq->i[i] * 32 / 2048);
        int y = cy - (iq->q[i] * 32 / 2048);
        oled_set_px(x, y, 1);
    }
    oled_flush();
}

void display_audio(uint8_t on, float gain, float shift)
{
    char line[24];
    oled_clear();
    oled_text(0, 0, "Audio Listen");
    snprintf(line, sizeof(line), "On:%d gain:%.0f", on, gain);
    oled_text(0, 12, line);
    snprintf(line, sizeof(line), "Shift:%.1fx", shift);
    oled_text(0, 24, line);
    oled_text(0, 52, "A=stop");
    oled_flush();
}

void display_fault(const char *msg)
{
    oled_clear();
    oled_text(0, 0, "! FAULT !");
    oled_text(0, 12, msg);
    oled_text(0, 52, "Fix & restart");
    oled_flush();
}

/* ── 5x7 font (ASCII 0x20..0x7F) ────────────────────────── */
const uint8_t font5x7[][5] = {
    {0x00,0x00,0x00,0x00,0x00},{0x00,0x00,0x5F,0x00,0x00},{0x00,0x07,0x00,0x07,0x00},
    {0x14,0x7F,0x14,0x7F,0x14},{0x24,0x2A,0x7F,0x2A,0x24},{0x23,0x13,0x08,0x64,0x62},
    {0x36,0x49,0x55,0x22,0x50},{0x00,0x05,0x03,0x00,0x00},{0x00,0x1C,0x22,0x41,0x00},
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    {0x00,0x03,0x07,0x08,0x00},{0x20,0x54,0x54,0x54,0x78}
};
## systems/soc-devices/cor-sono/firmware/sdkconfig.defaults
```kconfig
# Cor Sono — ESP32-S3 sdkconfig defaults

# Target chip
CONFIG_IDF_TARGET="esp32s3"

# Flash / PSRAM
CONFIG_ESPTOOLPY_FLASHSIZE_8MB=y
CONFIG_ESPTOOLPY_FLASHSIZE="8MB"
CONFIG_SPIRAM=y
CONFIG_SPIRAM_BOOT_INIT=y
CONFIG_SPIRAM_USE_MALLOC=y
CONFIG_SPIRAM_MEMTEST=y
CONFIG_SPIRAM_SPEED_80M=y
CONFIG_SPIRAM_MODE_OCTAL=y
CONFIG_SPIRAM_TRY_ALLOCATE_WIFI_LWIP=y

# Partition table (custom: model + audio + nvs)
CONFIG_PARTITION_TABLE_CUSTOM=y
CONFIG_PARTITION_TABLE_CUSTOM_FILENAME="partitions.csv"
CONFIG_PARTITION_TABLE_FILENAME="partitions.csv"

# FreeRTOS
CONFIG_FREERTOS_HZ=1000
CONFIG_FREERTOS_SMP=y

# BLE
CONFIG_BT_ENABLED=y
CONFIG_BT_BLE_42_FEATURES_ENABLED=y
CONFIG_BT_NIMBLE_MAX_CONNECTIONS=1
CONFIG_BT_NIMBLE_MAX_BONDS=4

# Wi-Fi
CONFIG_ESP_WIFI_STA_DISCONNECTED_PM_ENABLE=n

# PSRAM-aware malloc (for CNN weights + audio buffers)
CONFIG_SPIRAM_MALLOC_ALWAYSINTERNAL=16384

# Logging
CONFIG_LOG_DEFAULT_LEVEL_INFO=y
CONFIG_LOG_MAXIMUM_LEVEL_DEBUG=y
```

## systems/soc-devices/kappa-pin/firmware/sdkconfig.defaults
```kconfig
# Kappa Pin — ESP32-S3 sdkconfig defaults

# Target
CONFIG_IDF_TARGET="esp32s3"

# Flash / partition
CONFIG_ESPTOOLPY_FLASHSIZE_8MB=y
CONFIG_ESPTOOLPY_FLASHMODE_DIO=y
CONFIG_PARTITION_TABLE_SINGLE_APP=y

# FreeRTOS
CONFIG_FREERTOS_HZ=1000
CONFIG_FREERTOS_ENABLE_TASK_SNAPSHOT=y

# SPI master
CONFIG_SPI_MASTER_IN_IRAM=y

# SD card (SPI mode)
CONFIG_FATFS_LFN_STACK=y

# BLE (NimBLE)
CONFIG_BT_ENABLED=y
CONFIG_BT_NIMBLE_ENABLED=y
CONFIG_BT_NIMBLE_ROLE_PERIPHERAL=y
CONFIG_BT_NIMBLE_ROLE_BROADCASTER=y
CONFIG_BT_NIMBLE_MAX_CONNECTIONS=1
CONFIG_BT_NIMBLE_ATT_MTU=256

# Wi-Fi (softAP + STA)
CONFIG_ESP_WIFI_ENABLED=y
CONFIG_ESP_WIFI_SOFTAP_SUPPORT=y

# HTTP server
CONFIG_ESP_HTTP_SERVER_ENABLED=y

# NVS
CONFIG_NVS_ENCRYPTION=n

# PSRAM (not populated on WROOM-1-N8R2 base, but supported)
CONFIG_SPIRAM=n

# Watchdog
CONFIG_ESP_TASK_WDT_TIMEOUT_S=10

# Logging
CONFIG_LOG_DEFAULT_LEVEL_INFO=y
CONFIG_LOG_MAXIMUM_LEVEL_DEBUG=y
```

## systems/soc-devices/visco-shear/firmware/esp32c3/sdkconfig.defaults
```kconfig
# Visco Shear ESP32-C3 — sdkconfig defaults

CONFIG_IDF_TARGET="esp32c3"

CONFIG_ESPTOOLPY_FLASHSIZE_4MB=y
CONFIG_ESPTOOLPY_FLASHMODE_DIO=y
CONFIG_PARTITION_TABLE_SINGLE_APP=y

CONFIG_FREERTOS_HZ=1000

# BLE (NimBLE)
CONFIG_BT_ENABLED=y
CONFIG_BT_NIMBLE_ENABLED=y
CONFIG_BT_NIMBLE_ROLE_PERIPHERAL=y
CONFIG_BT_NIMBLE_ROLE_BROADCASTER=y
CONFIG_BT_NIMBLE_MAX_CONNECTIONS=1
CONFIG_BT_NIMBLE_ATT_MTU=256

# Wi-Fi (softAP + STA)
CONFIG_ESP_WIFI_ENABLED=y
CONFIG_ESP_WIFI_SOFTAP_SUPPORT=y

# HTTP server
CONFIG_ESP_HTTP_SERVER_ENABLED=y

# NVS
CONFIG_NVS_ENCRYPTION=n

# Logging
CONFIG_LOG_DEFAULT_LEVEL_INFO=y
```

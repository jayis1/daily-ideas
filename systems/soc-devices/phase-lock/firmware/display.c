/*
 * display.c — SH1106 OLED 128×64: live R/θ/X/Y + sweep plot
 *
 * The SH1106 is a 128×64 monochrome OLED on I2C (PA11/PA12). We use a
 * small 6×8 font (96 chars across 16 columns × 8 rows). The display
 * is page-addressed (8 pages of 128 bytes). We keep a 1 KB RAM frame
 * buffer and flush dirty pages on each update.
 */

#include "stm32g491_conf.h"
#include "display.h"
#include "i2c.h"
#include <string.h>
#include <stdio.h>

#define OLED_ADDR 0x3C
#define WIDTH 128
#define HEIGHT 64

static uint8_t framebuffer[WIDTH * HEIGHT / 8];
static uint8_t dirty_pages;

extern const uint8_t font5x8[][5];

static void oled_cmd(uint8_t cmd)
{
    uint8_t buf[2] = { 0x00, cmd };
    i2c_write(OLED_ADDR, buf, 2);
}

void display_init(void)
{
    /* SH1106 init sequence */
    oled_cmd(0xAE);              /* display off */
    oled_cmd(0xD5); oled_cmd(0x50);  /* osc divider */
    oled_cmd(0x20); oled_cmd(0x02);  /* page addressing */
    oled_cmd(0xA8); oled_cmd(0x3F);  /* multiplex 1/64 */
    oled_cmd(0xD3); oled_cmd(0x00);  /* display offset 0 */
    oled_cmd(0x40);              /* start line 0 */
    oled_cmd(0x8D); oled_cmd(0x14);  /* charge pump on */
    oled_cmd(0xA1);              /* seg remap */
    oled_cmd(0xC8);              /* com scan dir */
    oled_cmd(0xDA); oled_cmd(0x12);  /* com pins */
    oled_cmd(0x81); oled_cmd(0xCF);  /* contrast */
    oled_cmd(0xD9); oled_cmd(0xF1);  /* precharge */
    oled_cmd(0xDB); oled_cmd(0x40);  /* vcom deselect */
    oled_cmd(0xA4);              /* display RAM */
    oled_cmd(0xA6);              /* normal display */
    oled_cmd(0xAF);              /* display on */
    display_clear();
}

void display_clear(void)
{
    memset(framebuffer, 0, sizeof(framebuffer));
    dirty_pages = 0xFF;
}

static void set_pixel(int x, int y, int on)
{
    if (x < 0 || x >= WIDTH || y < 0 || y >= HEIGHT) return;
    int page = y / 8;
    int bit  = y % 8;
    if (on) framebuffer[page * WIDTH + x] |=  (1U << bit);
    else    framebuffer[page * WIDTH + x] &= ~(1U << bit);
    dirty_pages |= (1U << page);
}

static void put_char(int x, int y, char c)
{
    if (c < 32 || c > 127) c = '?';
    const uint8_t *g = font5x8[c - 32];
    for (int i = 0; i < 5; ++i) {
        for (int j = 0; j < 8; ++j) {
            set_pixel(x + i, y + j, g[i] & (1U << j));
        }
    }
}

static void put_str(int x, int y, const char *s)
{
    while (*s) { put_char(x, y, *s++); x += 6; }
}

static void flush_dirty(void)
{
    for (int p = 0; p < 8; ++p) {
        if (!(dirty_pages & (1U << p))) continue;
        oled_cmd(0xB0 + p);            /* page addr */
        oled_cmd(0x02);                /* col low (SH1106 offset 2) */
        oled_cmd(0x10);                /* col high */
        uint8_t buf[1 + WIDTH];
        buf[0] = 0x40;                  /* data */
        memcpy(buf + 1, &framebuffer[p * WIDTH], WIDTH);
        i2c_write(OLED_ADDR, buf, sizeof(buf));
    }
    dirty_pages = 0;
}

void display_show_status(const char *mode, float f, const char *tc_label)
{
    char line[22];
    snprintf(line, sizeof(line), "%-6s f=%9.3fHz", mode, f);
    put_str(0, 0, line);
    snprintf(line, sizeof(line), "TC=%s", tc_label);
    put_str(0, 8, line);
    flush_dirty();
}

void display_show_demod(demod_result_t r, float gain)
{
    char line[22];
    snprintf(line, sizeof(line), "R=%9.6f V", r.R);
    put_str(0, 16, line);
    snprintf(line, sizeof(line), "Th=%+7.1f deg", r.theta * 57.2958f);
    put_str(0, 24, line);
    snprintf(line, sizeof(line), "X=%+9.6f Y=%+9.6f", r.X, r.Y);
    put_str(0, 32, line);
    snprintf(line, sizeof(line), "N=%.1f nV/rHz", r.noise * 1e9f);
    put_str(0, 40, line);
    snprintf(line, sizeof(line), "G=%.0fx", gain);
    put_str(0, 48, line);
    flush_dirty();
}

void display_show_sweep(sweep_state_t *s)
{
    char line[22];
    if (s->mode == SWEEP_FREQ) {
        snprintf(line, sizeof(line), "SWP %u/%u  f=%.1f",
                 s->cur_point, s->n_points, sweep_current_freq());
    } else {
        snprintf(line, sizeof(line), "SWP %u/%u  A=%.2f",
                 s->cur_point, s->n_points, sweep_current_amp());
    }
    put_str(0, 0, line);
    /* mini Bode plot: R vs. point (64×32 area) */
    demod_result_t r = demod_read();
    int px = (int)((float)s->cur_point / s->n_points * 96.0f);
    int py = 56 - (int)(r.R * 30.0f);
    if (py < 24) py = 24;
    if (py > 56) py = 56;
    set_pixel(px + 16, py, 1);
    flush_dirty();
}

void display_show_menu(int item)
{
    const char *items[] = {
        "FREQ", "AMPL", "TC", "SLOPE",
        "GAIN", "SWEEP", "RUN", "LOG"
    };
    char line[22];
    for (int i = 0; i < 8; ++i) {
        snprintf(line, sizeof(line), "%c %-7s", (i == item) ? '>' : ' ', items[i]);
        put_str(0, i * 8, line);
    }
    flush_dirty();
}

void display_show_message(const char *l1, const char *l2)
{
    display_clear();
    put_str(0, 28, l1);
    put_str(0, 40, l2);
    flush_dirty();
}

/* 6×8 ASCII font (96 chars, 32..127). Each char is 5 cols × 8 rows. */
const uint8_t font5x8[][5] = {
    {0x00,0x00,0x00,0x00,0x00}, {0x00,0x00,0x5F,0x00,0x00}, {0x00,0x07,0x00,0x07,0x00},
    {0x14,0x7F,0x14,0x7F,0x14}, {0x24,0x2A,0x7F,0x2A,0x24}, {0x23,0x13,0x08,0x64,0x62},
    {0x36,0x49,0x55,0x22,0x50}, {0x00,0x05,0x03,0x00,0x00}, {0x00,0x1C,0x22,0x41,0x00},
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    {0x7F,0x21,0x21,0x21,0x1E}, {0x3E,0x41,0x41,0x41,0x3E}, {0x7F,0x02,0x04,0x08,0x7F},
};
/*
 * classifier.c — int8 1D-CNN wingbeat species classifier
 *
 * Pipeline:
 *   1. 256-point FFT of mic 1 + mic 2 (two magnitude spectra)
 *   2. Normalize and quantize to int8
 *   3. 3-layer 1D-CNN (Conv1D 8→16→32, kernel 5, ReLU, GAP, Dense)
 *   4. Softmax → 12 classes (11 species + unknown)
 *
 * The CNN weights are in model_weights.c (generated by scripts/train_model.py).
 * Inference uses int8 arithmetic (ESP32-S3 vector instructions accelerate MACs).
 *
 * Architecture (8 KB quantized model):
 *   Input:  [2 × 129] int8  (2 mics × 129 FFT bins)
 *   Conv1D: 8 filters, kernel 5, stride 2  → [8 × 63]
 *   Conv1D: 16 filters, kernel 5, stride 2 → [16 × 30]
 *   Conv1D: 32 filters, kernel 5, stride 1 → [32 × 26]
 *   GAP:                                  → [32]
 *   Dense: 12 classes (softmax)
 *
 * Copyright (c) 2026 SoC Device Inventions. MIT License.
 */

#include "config.h"
#include "classifier.h"
#include "model_weights.h"
#include "esp_log.h"
#include <math.h>
#include <string.h>

static const char *TAG = "classifier";

/* ---- FFT (radix-2 Cooley-Tukey, in-place, 256-point) ---- */
static float s_fft_real[FFT_SIZE];
static float s_fft_imag[FFT_SIZE];
static float s_fft_mag[FFT_BINS * 2];   /* 2 mics × 129 bins */
static int8_t s_quant_input[FFT_BINS * 2];

/* Bit-reversal table for 256-point FFT */
static uint8_t s_bit_rev[FFT_SIZE];

static void fft_init_tables(void)
{
    for (int i = 0; i < FFT_SIZE; i++) {
        uint8_t rev = 0;
        int v = i;
        for (int b = 0; b < 8; b++) {
            rev = (rev << 1) | (v & 1);
            v >>= 1;
        }
        s_bit_rev[i] = rev;
    }
}

/* 256-point in-place radix-2 FFT */
static void fft256(float *re, float *im)
{
    int n = FFT_SIZE;
    /* Bit-reversal permutation */
    for (int i = 0; i < n; i++) {
        int j = s_bit_rev[i];
        if (j > i) {
            float tr = re[i]; re[i] = re[j]; re[j] = tr;
            float ti = im[i]; im[i] = im[j]; im[j] = ti;
        }
    }
    /* Butterfly stages */
    for (int len = 2; len <= n; len *= 2) {
        float angle = -2.0f * M_PI / len;
        float wr = cosf(angle);
        float wi = sinf(angle);
        for (int i = 0; i < n; i += len) {
            float cur_wr = 1.0f, cur_wi = 0.0f;
            for (int j = 0; j < len / 2; j++) {
                int k1 = i + j;
                int k2 = i + j + len / 2;
                float tr = cur_wr * re[k2] - cur_wi * im[k2];
                float ti = cur_wr * im[k2] + cur_wi * re[k2];
                re[k2] = re[k1] - tr;
                im[k2] = im[k1] - ti;
                re[k1] = re[k1] + tr;
                im[k1] = im[k1] + ti;
                float new_wr = cur_wr * wr - cur_wi * wi;
                cur_wi = cur_wr * wi + cur_wi * wr;
                cur_wr = new_wr;
            }
        }
    }
}

/* Compute magnitude spectrum from real input (Hann windowed) */
static void compute_magnitude_spectrum(const int16_t *input, float *mag_out)
{
    /* Apply Hann window and load into FFT buffers */
    for (int i = 0; i < FFT_SIZE; i++) {
        float window = 0.5f * (1.0f - cosf(2.0f * M_PI * i / (FFT_SIZE - 1)));
        s_fft_real[i] = (float)input[i] * window;
        s_fft_imag[i] = 0.0f;
    }

    fft256(s_fft_real, s_fft_imag);

    /* Magnitude of first 129 bins (one-sided spectrum) */
    for (int i = 0; i < FFT_BINS; i++) {
        float mag = sqrtf(s_fft_real[i] * s_fft_real[i] +
                          s_fft_imag[i] * s_fft_imag[i]);
        mag_out[i] = mag;
    }
}

/* ---- Conv1D (int8) ---- */
typedef struct {
    int8_t  *weights;   /* [out_ch × in_ch × kernel] */
    int32_t *biases;    /* [out_ch] */
    int      in_ch;
    int      out_ch;
    int      kernel;
    int      stride;
} conv1d_layer_t;

static int conv1d_output_len(int input_len, int kernel, int stride)
{
    return (input_len - kernel) / stride + 1;
}

/* int8 Conv1D with ReLU activation */
static void conv1d_int8(const int8_t *input, int input_len,
                         const conv1d_layer_t *layer,
                         int8_t *output)
{
    int out_len = conv1d_output_len(input_len, layer->kernel, layer->stride);
    for (int oc = 0; oc < layer->out_ch; oc++) {
        for (int pos = 0; pos < out_len; pos++) {
            int32_t acc = layer->biases[oc];
            int in_start = pos * layer->stride;
            for (int ic = 0; ic < layer->in_ch; ic++) {
                for (int k = 0; k < layer->kernel; k++) {
                    int idx = in_start + k;
                    if (idx < input_len) {
                        int w_idx = ((oc * layer->in_ch + ic) * layer->kernel + k);
                        acc += (int32_t)input[ic * input_len + idx] *
                               layer->weights[w_idx];
                    }
                }
            }
            /* ReLU + requantize to int8 (divide by 128) */
            if (acc < 0) acc = 0;
            acc >>= 7;  /* requantize (scale factor baked into training) */
            if (acc > 127) acc = 127;
            output[oc * out_len + pos] = (int8_t)acc;
        }
    }
}

/* Global Average Pooling */
static void gap_int8(const int8_t *input, int channels, int length, int8_t *output)
{
    for (int c = 0; c < channels; c++) {
        int32_t sum = 0;
        for (int i = 0; i < length; i++) {
            sum += input[c * length + i];
        }
        output[c] = (int8_t)(sum / length);
    }
}

/* Dense (fully connected) layer — int8 weights, float output (for softmax) */
static void dense_int8(const int8_t *input, int input_len,
                       const int8_t *weights, const int32_t *biases,
                       int out_len, float *output)
{
    for (int o = 0; o < out_len; o++) {
        int32_t acc = biases[o];
        for (int i = 0; i < input_len; i++) {
            acc += (int32_t)input[i] * weights[o * input_len + i];
        }
        output[o] = (float)acc;
    }
}

/* Softmax */
static void softmax(float *input, int len)
{
    float max = input[0];
    for (int i = 1; i < len; i++) if (input[i] > max) max = input[i];
    float sum = 0.0f;
    for (int i = 0; i < len; i++) {
        input[i] = expf(input[i] - max);
        sum += input[i];
    }
    for (int i = 0; i < len; i++) input[i] /= sum;
}

/* ---- Layer buffers ---- */
static int8_t  s_conv1_out[8 * 63];
static int8_t  s_conv2_out[16 * 30];
static int8_t  s_conv3_out[32 * 26];
static int8_t  s_gap_out[32];
static float  s_logits[NUM_CLASSES];

/* Layer definitions (weights from model_weights.c) */
static conv1d_layer_t s_conv1 = {
    .weights = conv1_w, .biases = conv1_b,
    .in_ch = 2, .out_ch = 8, .kernel = 5, .stride = 2
};
static conv1d_layer_t s_conv2 = {
    .weights = conv2_w, .biases = conv2_b,
    .in_ch = 8, .out_ch = 16, .kernel = 5, .stride = 2
};
static conv1d_layer_t s_conv3 = {
    .weights = conv3_w, .biases = conv3_b,
    .in_ch = 16, .out_ch = 32, .kernel = 5, .stride = 1
};

void classifier_init(void)
{
    ESP_LOGI(TAG, "Initializing 1D-CNN classifier (%d classes, %d-point FFT, int8)",
             NUM_CLASSES, FFT_SIZE);
    fft_init_tables();
    /* Verify model weights are loaded */
    if (conv1_w[0] == 0 && conv1_w[1] == 0 && conv1_w[2] == 0) {
        ESP_LOGW(TAG, "Model weights appear to be placeholder zeros — "
                      "run scripts/train_model.py to generate real weights");
    }
}

void classifier_inference(const audio_frame_t *frame,
                           uint8_t *species_id,
                           float *confidence,
                           float *wingbeat_hz)
{
    /* Step 1: FFT magnitude spectra for both mics */
    compute_magnitude_spectrum(frame->mic1, s_fft_mag);
    compute_magnitude_spectrum(frame->mic2, s_fft_mag + FFT_BINS);

    /* Step 2: Quantize to int8 (normalize by max magnitude) */
    float max_mag = 1e-6f;
    for (int i = 0; i < FFT_BINS * 2; i++) {
        if (s_fft_mag[i] > max_mag) max_mag = s_fft_mag[i];
    }
    float scale = 127.0f / max_mag;
    for (int i = 0; i < FFT_BINS * 2; i++) {
        s_quant_input[i] = (int8_t)(s_fft_mag[i] * scale);
    }

    /* Step 3: Conv1D layers */
    conv1d_int8(s_quant_input, FFT_BINS, &s_conv1, s_conv1_out);
    conv1d_int8(s_conv1_out, conv1d_output_len(FFT_BINS, 5, 2),
                &s_conv2, s_conv2_out);
    conv1d_int8(s_conv2_out, conv1d_output_len(63, 5, 2),
                &s_conv3, s_conv3_out);

    /* Step 4: Global Average Pooling */
    gap_int8(s_conv3_out, 32, conv1d_output_len(30, 5, 1), s_gap_out);

    /* Step 5: Dense layer → logits */
    dense_int8(s_gap_out, 32, dense_w, dense_b, NUM_CLASSES, s_logits);

    /* Step 6: Softmax → probabilities */
    softmax(s_logits, NUM_CLASSES);

    /* Step 7: Pick top-1 class */
    float best_prob = 0.0f;
    int best_class = SPECIES_UNKNOWN;
    for (int i = 0; i < NUM_CLASSES; i++) {
        if (s_logits[i] > best_prob) {
            best_prob = s_logits[i];
            best_class = i;
        }
    }

    *species_id  = (uint8_t)best_class;
    *confidence = best_prob;

    /* Estimate wingbeat frequency from the FFT peak (30 Hz – 1500 Hz range) */
    float bin_hz = (float)I2S_SAMPLE_RATE_HZ / FFT_SIZE;
    int min_bin = (int)(AUTOCORR_MIN_HZ / bin_hz);
    int max_bin = (int)(AUTOCORR_MAX_HZ / bin_hz);
    float peak_mag = 0.0f;
    int peak_bin = 0;
    for (int i = min_bin; i < max_bin && i < FFT_BINS; i++) {
        if (s_fft_mag[i] > peak_mag) {
            peak_mag = s_fft_mag[i];
            peak_bin = i;
        }
    }
    *wingbeat_hz = peak_bin * bin_hz;
}